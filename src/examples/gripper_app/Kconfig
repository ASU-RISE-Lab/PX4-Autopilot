## src/examples/gripper_app/Kconfig
```kconfig
menuconfig EXAMPLES_GRIPPER_APP
	bool "gripper_app"
	default n
	---help---
		Enable support for gripper_app
```

## src/examples/gripper_engage_app/Kconfig
```kconfig
menuconfig EXAMPLES_GRIPPER_ENGAGE_APP
	bool "gripper_engage_app"
	default n
	---help---
		Enable support for gripper_engage_app
```
